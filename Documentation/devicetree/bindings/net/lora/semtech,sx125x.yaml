## Documentation/devicetree/bindings/net/lora/semtech,sx125x.yaml
```yaml
# SPDX-License-Identifier: (GPL-2.0 OR BSD-2-Clause)
%YAML 1.2
---
$id: http://devicetree.org/schemas/net/lora/semtech,sx125x.yaml#
$schema: http://devicetree.org/meta-schemas/core.yaml#

title: Semtech IQ modulator/de-modulator transeiver

maintainers:
  - Andreas Färber <afaerber@suse.de>
  - Ben Whitten <ben.whitten@gmail.com>

description: |
  The SX125x family are transceivers capable of supporting multiple constant
  and non-constant envelope modulation schemes.

properties:
  compatible:
    items:
      - enum:
        - semtech,sx1255
        - semtech,sx1257
        - semtech,sx1258

  reg:
    maxItems: 1
    description: The chip select on the SPI bus or radio number in concentrator
      , with radio A = 0 and radio B = 1.

  clocks:
    minItems: 1
    maxItems: 2
    items:
      - description: 32 MHz to 36 MHz clock provider (FXOSC)
      - description: 32 MHz to 36 MHz TX clock privider (FCLK_IN)
    description: Input clock (FXOSC) provider with output ranging from 32 MHz
      to 36 MHz. TX synthesizer or DAC input clock (FCLK_IN) provider with
      output ranging from 32 MHz to 36 MHz.

  clock-names:
    minItems: 1
    maxItems: 2
    items:
      - const: fxosc
      - const: fclk_in
    description: Input clock (FXOSC), TX synthesizer or DAC input clock
      (FCLK_IN)

  clock-output-names:
    items:
      - const: fclk_out
    description: Output clock (FCLK_OUT) name, clock is gated version of the
      input (FXOSC). Used in master mode operation.

  '#clock-cells':
    const: 0

required:
  - compatible
  - reg

examples:
  - |
    tcxo: dummy32m {
      compatible = "fixed-clock";
      clock-frequency = <32000000>;
      clock-output-names = "tcxo";
      #clock-cells = <0>;
    };

    spi {
      #address-cells = <1>;
      #size-cells = <0>;

      radio0: radio@0 {
        compatible = "semtech,sx1257";
        reg = <0>;
        clocks = <&tcxo>;
        clock-names = "fxosc";
        clock-output-names = "fclk_out";
        #clock-cells = <0>;
      };
    };
```

## Documentation/devicetree/bindings/net/lora/semtech,sx130x.yaml
```yaml
# SPDX-License-Identifier: (GPL-2.0 OR BSD-2-Clause)
%YAML 1.2
---
$id: http://devicetree.org/schemas/net/lora/semtech,sx130x.yaml#
$schema: http://devicetree.org/meta-schemas/core.yaml#

title: Semtech LoRa concentrator

maintainers:
  - Andreas Färber <afaerber@suse.de>
  - Ben Whitten <ben.whitten@gmail.com>

description: |
  Semtech LoRa concentrator SX130x digital baseband chip is capable of
  demodulating LoRa signals on 8 channels simultaneously.

  It is typically paired with two SX125x IQ radios controlled over an
  SPI directly from the concentrator. One of the radios will provide
  a 32 MHz clock back into the concentrator.
  The concentrator also outputs a 32 MHz clock to the radio(s) in the TX chain.

  The concentrator itself is controlled over SPI.

properties:
  compatible:
    oneOf:
      - items:
        - enum:
          - semtech,sx1308
        - const: semtech,sx1301
      - items:
        - const: semtech,sx1301

  reg:
    maxItems: 1
    description: The chip select on the SPI bus.

  reset-gpios:
    maxItems: 1
    description: A connection of the reset gpio line.

  clocks:
    maxItems: 2
    items:
      - description: 32 MHz clock provider (CLK32M)
      - description: 133 MHz high speed clock provider (CLKHS)
    description: The chip requires two clock inputs; A 32MHz clock at CMOS
      level which is provided from a connected radio.
      And a 133MHz high speed clock at CMOS level provided by an oscillator.

  clock-names:
    items:
      - const: clk32m
      - const: clkhs
    description: Input clock (CLK32M) name from provider, Input clock (CLKHS)
      name from provider.

  clock-output-names:
    items:
      - const: sp_clk_out
    description: Output clock (SP_CLK_OUT) typically connected to the TX radio.

  '#clock-cells':
    const: 0

  semtech,power-lut:
    description: Power lookup table for the concentrator.
    allOf:
      - $ref: "/schemas/types.yaml#/definitions/uint8-matrix"
      - maxItems: 16
        items:
          items:
            - description: Power in dBm measured at the rf connector.
#              minimum: -6
#              maximum: 27
            - description: Digital gain.
              minimum: 0
              maximum: 3
            - description: PA gain.
              minimum: 0
              maximum: 3
            - description: DAC gain.
              minimum: 3
              maximum: 3
            - description: Mixer gain.
              minimum: 8
              maximum: 15

  radio-spi:
    type: object
    description: The concentrator can have two radios connected which are
      contained within the following node.

    properties:
      '#address-cells':
        const: 1

      '#size-cells':
        const: 0

    patternProperties:
      "^radio@[0-1]$":
        type: object
        properties:
          reg:
            maxItems: 1
        required:
          - reg

    required:
      - '#address-cells'
      - '#size-cells'

required:
  - compatible
  - reg

examples:
  - |

    #include <dt-bindings/gpio/gpio.h>

    tcxo: dummy32m {
      compatible = "fixed-clock";
      clock-frequency = <32000000>;
      clock-output-names = "tcxo";
      #clock-cells = <0>;
    };

    clkhs: dummy133m {
      compatible = "fixed-clock";
      clock-frequency = <133000000>;
      clock-output-names = "clkhs";
      #clock-cells = <0>;
    };

    spi {
      #address-cells = <1>;
      #size-cells = <0>;

      concentrator0: lora@0 {
        compatible = "semtech,sx1301";
        reg = <0>;
        reset-gpios = <&pioB 27 GPIO_ACTIVE_HIGH>;
        spi-max-frequency = <8000000>;
        clocks = <&radio1>, <&clkhs>;
        clock-names = "clk32m", "clkhs";
        clock-output-names = "sp_clk_out";
        #clock-cells = <0>;

        semtech,power-lut = /bits/ 8 < 0xFD 0 0 3  9 >,
                            /bits/ 8 <    3 0 0 3 12 >,
                            /bits/ 8 <    4 0 0 3 13 >;

        radio-spi {
          #address-cells = <1>;
          #size-cells = <0>;

          radio0: radio@0 {
            compatible = "semtech,sx1257";
            reg = <0>;
            clocks = <&tcxo>, <&concentrator0>;
            clock-names = "fxosc", "fclk_in";
          };

          radio1: radio@1 {
            compatible = "semtech,sx1257";
            reg = <1>;
            clocks = <&tcxo>;
            clock-names = "fxosc";
            clock-output-names = "fclk_out";
            #clock-cells = <0>;
          };
        };
      };
    };
```
